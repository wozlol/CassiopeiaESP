## components/a11_font/Kconfig.projbuild
```kconfig
menu "A-11 font"
    config A11_FONT_SMALL_ONLY
        bool "Only the two smallest font sizes"
        default n
        help
            Leaves out the larger font tables, for the small loader image.
endmenu
```

## components/ssh/Kconfig.projbuild
```kconfig
menu "SSH client"
    config SSH_KEEPALIVE_INTERVAL
        int "SSH keep-alive interval (seconds), 0 turns it off"
        default 30
        range 0 300
    config SSH_RECV_WINDOW
        int "SSH receive window size (bytes)"
        default 262144
        range 4096 262144
    config SSH_WIFI_PS_NONE
        bool "Turn Wi-Fi power save off while an SSH session is open"
        default y
endmenu
```
